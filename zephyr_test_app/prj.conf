## CMakeLists.txt
```
cmake_minimum_required(VERSION 3.20.0)
find_package(Zephyr REQUIRED HINTS $ENV{ZEPHYR_BASE})
project(zsign_blinky)

target_sources(app PRIVATE src/main.c)
```

## Kconfig
```
mainmenu "Zsign blinky (MCUboot demo app) configuration"

config APP_BLINK_PERIOD_MS
	int "LED blink half-period in milliseconds"
	default 1000
	help
	  Time the LED stays on (and off) per toggle. Overridden per-build
	  by the DFU demo script (-DCONFIG_APP_BLINK_PERIOD_MS=<ms>) rather
	  than edited here, so a "new version" is a build-time parameter,
	  not a source change.

source "Kconfig.zephyr"
```

## prj.conf
```kconfig
# Built standalone (no sysbuild): MCUboot is built and flashed
# separately. CONFIG_MCUBOOT_SIGNATURE_KEY_FILE defaults to "", so the
# default build does NOT try to sign with a private key -- per
# spec.md's "Separate Bootloader Provisioning from Application Signing".
CONFIG_BOOTLOADER_MCUBOOT=y

CONFIG_GPIO=y
CONFIG_PRINTK=y
CONFIG_CONSOLE=y
```

## src/main.c
```c
/*
 * Minimal MCUboot-bootable blinky, used as the Zsign Phase 4 DFU demo
 * target: the agent signs a build of this app, it gets flashed into
 * MCUboot's primary slot, and the blink period is the one observable
 * signal that the "new" signed image is actually running.
 */

#include <zephyr/kernel.h>
#include <zephyr/device.h>
#include <zephyr/drivers/gpio.h>
#include <zephyr/sys/printk.h>

#ifdef APP_VERSION_STRING
#include <app_version.h>
#endif

static const struct gpio_dt_spec led = GPIO_DT_SPEC_GET(DT_ALIAS(led0), gpios);

int main(void)
{
#ifdef APP_VERSION_STRING
	printk("zsign blinky boot: version=%s blink_period_ms=%d\n",
	       APP_VERSION_STRING, CONFIG_APP_BLINK_PERIOD_MS);
#else
	printk("zsign blinky boot: blink_period_ms=%d\n", CONFIG_APP_BLINK_PERIOD_MS);
#endif

	if (!gpio_is_ready_dt(&led)) {
		printk("LED device not ready\n");
		return 0;
	}
	gpio_pin_configure_dt(&led, GPIO_OUTPUT_INACTIVE);

	while (1) {
		gpio_pin_toggle_dt(&led);
		k_msleep(CONFIG_APP_BLINK_PERIOD_MS);
	}
	return 0;
}
```
