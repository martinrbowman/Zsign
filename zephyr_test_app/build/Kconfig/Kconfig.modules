## zephyr_test_app/mcuboot_build/Kconfig/soc/Kconfig.soc.tmp
```kconfig
# Load SoC Kconfig descriptions.
osource "/Volumes/embedded/zephyr_install/external/zephyr/soc/xlnx/zynqmp/Kconfig.soc"
osource "/Volumes/embedded/zephyr_install/external/zephyr/soc/xlnx/zynq7000/Kconfig.soc"
osource "/Volumes/embedded/zephyr_install/external/zephyr/soc/xlnx/versalnet/Kconfig.soc"
osource "/Volumes/embedded/zephyr_install/external/zephyr/soc/xlnx/versal2/Kconfig.soc"
osource "/Volumes/embedded/zephyr_install/external/zephyr/soc/xlnx/versal/Kconfig.soc"
osource "/Volumes/embedded/zephyr_install/external/zephyr/soc/xen/Kconfig.soc"
osource "/Volumes/embedded/zephyr_install/external/zephyr/soc/wch/ch32v/Kconfig.soc"
osource "/Volumes/embedded/zephyr_install/external/zephyr/soc/ti/simplelink/Kconfig.soc"
osource "/Volumes/embedded/zephyr_install/external/zephyr/soc/ti/mspm0/Kconfig.soc"
osource "/Volumes/embedded/zephyr_install/external/zephyr/soc/ti/lm3s6965/Kconfig.soc"
osource "/Volumes/embedded/zephyr_install/external/zephyr/soc/ti/k3/Kconfig.soc"
osource "/Volumes/embedded/zephyr_install/external/zephyr/soc/telink/tlsr/Kconfig.soc"
osource "/Volumes/embedded/zephyr_install/external/zephyr/soc/syna/sr100/Kconfig.soc"
osource "/Volumes/embedded/zephyr_install/external/zephyr/soc/starfive/jh71xx/Kconfig.soc"
osource "/Volumes/embedded/zephyr_install/external/zephyr/soc/st/stm32/Kconfig.soc"
osource "/Volumes/embedded/zephyr_install/external/zephyr/soc/snps/qemu_arc/Kconfig.soc"
osource "/Volumes/embedded/zephyr_install/external/zephyr/soc/snps/nsim/arc_v/Kconfig.soc"
osource "/Volumes/embedded/zephyr_install/external/zephyr/soc/snps/nsim/arc_classic/Kconfig.soc"
osource "/Volumes/embedded/zephyr_install/external/zephyr/soc/snps/hsdk4xd/Kconfig.soc"
osource "/Volumes/embedded/zephyr_install/external/zephyr/soc/snps/hsdk/Kconfig.soc"
osource "/Volumes/embedded/zephyr_install/external/zephyr/soc/snps/emsk/Kconfig.soc"
osource "/Volumes/embedded/zephyr_install/external/zephyr/soc/snps/emsdp/Kconfig.soc"
osource "/Volumes/embedded/zephyr_install/external/zephyr/soc/snps/arc_iot/Kconfig.soc"
osource "/Volumes/embedded/zephyr_install/external/zephyr/soc/silabs/Kconfig.soc"
osource "/Volumes/embedded/zephyr_install/external/zephyr/soc/sifli/sf32/Kconfig.soc"
osource "/Volumes/embedded/zephyr_install/external/zephyr/soc/sifive/sifive_freedom/Kconfig.soc"
osource "/Volumes/embedded/zephyr_install/external/zephyr/soc/sensry/Kconfig.soc"
osource "/Volumes/embedded/zephyr_install/external/zephyr/soc/rockchip/Kconfig.soc"
osource "/Volumes/embedded/zephyr_install/external/zephyr/soc/renode/riscv_virtual/Kconfig.soc"
osource "/Volumes/embedded/zephyr_install/external/zephyr/soc/renode/cortex_r8_virtual/Kconfig.soc"
osource "/Volumes/embedded/zephyr_install/external/zephyr/soc/renesas/smartbond/Kconfig.soc"
osource "/Volumes/embedded/zephyr_install/external/zephyr/soc/renesas/rz/Kconfig.soc"
osource "/Volumes/embedded/zephyr_install/external/zephyr/soc/renesas/rx/Kconfig.soc"
osource "/Volumes/embedded/zephyr_install/external/zephyr/soc/renesas/rcar/Kconfig.soc"
osource "/Volumes/embedded/zephyr_install/external/zephyr/soc/renesas/ra/Kconfig.soc"
osource "/Volumes/embedded/zephyr_install/external/zephyr/soc/realtek/fingerprint/Kconfig.soc"
osource "/Volumes/embedded/zephyr_install/external/zephyr/soc/realtek/ec/Kconfig.soc"
osource "/Volumes/embedded/zephyr_install/external/zephyr/soc/realtek/bee/Kconfig.soc"
osource "/Volumes/embedded/zephyr_install/external/zephyr/soc/realtek/ameba/Kconfig.soc"
osource "/Volumes/embedded/zephyr_install/external/zephyr/soc/raspberrypi/rpi_pico/Kconfig.soc"
osource "/Volumes/embedded/zephyr_install/external/zephyr/soc/quicklogic/eos_s3/Kconfig.soc"
osource "/Volumes/embedded/zephyr_install/external/zephyr/soc/qemu/virt_riscv/Kconfig.soc"
osource "/Volumes/embedded/zephyr_install/external/zephyr/soc/qemu/or1k/Kconfig.soc"
osource "/Volumes/embedded/zephyr_install/external/zephyr/soc/qemu/malta/Kconfig.soc"
osource "/Volumes/embedded/zephyr_install/external/zephyr/soc/openisa/rv32m1/Kconfig.soc"
osource "/Volumes/embedded/zephyr_install/external/zephyr/soc/openhwgroup/cva6/Kconfig.soc"
osource "/Volumes/embedded/zephyr_install/external/zephyr/soc/oct/osd32mp15x/Kconfig.soc"
osource "/Volumes/embedded/zephyr_install/external/zephyr/soc/nxp/s32/Kconfig.soc"
osource "/Volumes/embedded/zephyr_install/external/zephyr/soc/nxp/rw/Kconfig.soc"
osource "/Volumes/embedded/zephyr_install/external/zephyr/soc/nxp/mcx/Kconfig.soc"
osource "/Volumes/embedded/zephyr_install/external/zephyr/soc/nxp/lpc/Kconfig.soc"
osource "/Volumes/embedded/zephyr_install/external/zephyr/soc/nxp/layerscape/Kconfig.soc"
osource "/Volumes/embedded/zephyr_install/external/zephyr/soc/nxp/kinetis/Kconfig.soc"
osource "/Volumes/embedded/zephyr_install/external/zephyr/soc/nxp/imxrt/Kconfig.soc"
osource "/Volumes/embedded/zephyr_install/external/zephyr/soc/nxp/imx/Kconfig.soc"
osource "/Volumes/embedded/zephyr_install/external/zephyr/soc/nuvoton/numicro/Kconfig.soc"
osource "/Volumes/embedded/zephyr_install/external/zephyr/soc/nuvoton/numaker/Kconfig.soc"
osource "/Volumes/embedded/zephyr_install/external/zephyr/soc/nuvoton/npcx/Kconfig.soc"
osource "/Volumes/embedded/zephyr_install/external/zephyr/soc/nuvoton/npcm/Kconfig.soc"
osource "/Volumes/embedded/zephyr_install/external/zephyr/soc/nordic/Kconfig.soc"
osource "/Volumes/embedded/zephyr_install/external/zephyr/soc/neorv32/Kconfig.soc"
osource "/Volumes/embedded/zephyr_install/external/zephyr/soc/native/inf_clock/Kconfig.soc"
osource "/Volumes/embedded/zephyr_install/external/zephyr/soc/microchip/sam/sama7/Kconfig.soc"
osource "/Volumes/embedded/zephyr_install/external/zephyr/soc/microchip/sam/sam_d5x_e5x/Kconfig.soc"
osource "/Volumes/embedded/zephyr_install/external/zephyr/soc/microchip/pic64/Kconfig.soc"
osource "/Volumes/embedded/zephyr_install/external/zephyr/soc/microchip/pic32c/pic32cz_ca/Kconfig.soc"
osource "/Volumes/embedded/zephyr_install/external/zephyr/soc/microchip/pic32c/pic32cx_sg/Kconfig.soc"
osource "/Volumes/embedded/zephyr_install/external/zephyr/soc/microchip/pic32c/pic32cm_pl/Kconfig.soc"
osource "/Volumes/embedded/zephyr_install/external/zephyr/soc/microchip/pic32c/pic32cm_jh/Kconfig.soc"
osource "/Volumes/embedded/zephyr_install/external/zephyr/soc/microchip/miv/Kconfig.soc"
osource "/Volumes/embedded/zephyr_install/external/zephyr/soc/microchip/mec/Kconfig.soc"
osource "/Volumes/embedded/zephyr_install/external/zephyr/soc/mediatek/mt8xxx/Kconfig.soc"
osource "/Volumes/embedded/zephyr_install/external/zephyr/soc/lowrisc/opentitan/Kconfig.soc"
osource "/Volumes/embedded/zephyr_install/external/zephyr/soc/litex/litex_vexriscv/Kconfig.soc"
osource "/Volumes/embedded/zephyr_install/external/zephyr/soc/ite/ec/Kconfig.soc"
osource "/Volumes/embedded/zephyr_install/external/zephyr/soc/intel/wildcat_lake/Kconfig.soc"
osource "/Volumes/embedded/zephyr_install/external/zephyr/soc/intel/raptor_lake/Kconfig.soc"
osource "/Volumes/embedded/zephyr_install/external/zephyr/soc/intel/panther_lake/Kconfig.soc"
osource "/Volumes/embedded/zephyr_install/external/zephyr/soc/intel/lakemont/Kconfig.soc"
osource "/Volumes/embedded/zephyr_install/external/zephyr/soc/intel/intel_socfpga_std/Kconfig.soc"
osource "/Volumes/embedded/zephyr_install/external/zephyr/soc/intel/intel_socfpga/Kconfig.soc"
osource "/Volumes/embedded/zephyr_install/external/zephyr/soc/intel/intel_niosv/Kconfig.soc"
osource "/Volumes/embedded/zephyr_install/external/zephyr/soc/intel/intel_ish/Kconfig.soc"
osource "/Volumes/embedded/zephyr_install/external/zephyr/soc/intel/intel_adsp/Kconfig.soc"
osource "/Volumes/embedded/zephyr_install/external/zephyr/soc/intel/elkhart_lake/Kconfig.soc"
osource "/Volumes/embedded/zephyr_install/external/zephyr/soc/intel/atom/Kconfig.soc"
osource "/Volumes/embedded/zephyr_install/external/zephyr/soc/intel/apollo_lake/Kconfig.soc"
osource "/Volumes/embedded/zephyr_install/external/zephyr/soc/intel/alder_lake/Kconfig.soc"
osource "/Volumes/embedded/zephyr_install/external/zephyr/soc/infineon/psoc4/Kconfig.soc"
osource "/Volumes/embedded/zephyr_install/external/zephyr/soc/infineon/edge/Kconfig.soc"
osource "/Volumes/embedded/zephyr_install/external/zephyr/soc/infineon/cat3/Kconfig.soc"
osource "/Volumes/embedded/zephyr_install/external/zephyr/soc/infineon/cat1c/Kconfig.soc"
osource "/Volumes/embedded/zephyr_install/external/zephyr/soc/infineon/cat1b/Kconfig.soc"
osource "/Volumes/embedded/zephyr_install/external/zephyr/soc/infineon/cat1a/Kconfig.soc"
osource "/Volumes/embedded/zephyr_install/external/zephyr/soc/gd/gd32/Kconfig.soc"
osource "/Volumes/embedded/zephyr_install/external/zephyr/soc/gaisler/leon3/Kconfig.soc"
osource "/Volumes/embedded/zephyr_install/external/zephyr/soc/gaisler/gr716a/Kconfig.soc"
osource "/Volumes/embedded/zephyr_install/external/zephyr/soc/focaltech/Kconfig.soc"
osource "/Volumes/embedded/zephyr_install/external/zephyr/soc/espressif/Kconfig.soc"
osource "/Volumes/embedded/zephyr_install/external/zephyr/soc/ene/kb1200/Kconfig.soc"
osource "/Volumes/embedded/zephyr_install/external/zephyr/soc/ene/kb106x/Kconfig.soc"
osource "/Volumes/embedded/zephyr_install/external/zephyr/soc/elan/em32f967/Kconfig.soc"
osource "/Volumes/embedded/zephyr_install/external/zephyr/soc/egis/Kconfig.soc"
osource "/Volumes/embedded/zephyr_install/external/zephyr/soc/efinix/sapphire/Kconfig.soc"
osource "/Volumes/embedded/zephyr_install/external/zephyr/soc/cdns/xtensa_sample_controller/Kconfig.soc"
osource "/Volumes/embedded/zephyr_install/external/zephyr/soc/cdns/swerv/Kconfig.soc"
osource "/Volumes/embedded/zephyr_install/external/zephyr/soc/cdns/sample_controller32/Kconfig.soc"
osource "/Volumes/embedded/zephyr_install/external/zephyr/soc/cdns/dc233c/Kconfig.soc"
osource "/Volumes/embedded/zephyr_install/external/zephyr/soc/brcm/bcmvk/Kconfig.soc"
osource "/Volumes/embedded/zephyr_install/external/zephyr/soc/brcm/bcm2712/Kconfig.soc"
osource "/Volumes/embedded/zephyr_install/external/zephyr/soc/brcm/bcm2711/Kconfig.soc"
osource "/Volumes/embedded/zephyr_install/external/zephyr/soc/blackberry/qnxhv_vm/Kconfig.soc"
osource "/Volumes/embedded/zephyr_install/external/zephyr/soc/bflb/Kconfig.soc"
osource "/Volumes/embedded/zephyr_install/external/zephyr/soc/atmel/sam0/Kconfig.soc"
osource "/Volumes/embedded/zephyr_install/external/zephyr/soc/atmel/sam/Kconfig.soc"
osource "/Volumes/embedded/zephyr_install/external/zephyr/soc/aspeed/Kconfig.soc"
osource "/Volumes/embedded/zephyr_install/external/zephyr/soc/arm/Kconfig.soc"
osource "/Volumes/embedded/zephyr_install/external/zephyr/soc/arm/beetle/Kconfig.soc"
osource "/Volumes/embedded/zephyr_install/external/zephyr/soc/antmicro/myra/Kconfig.soc"
osource "/Volumes/embedded/zephyr_install/external/zephyr/soc/andestech/Kconfig.soc"
osource "/Volumes/embedded/zephyr_install/external/zephyr/soc/amd/acp_6_0/Kconfig.soc"
osource "/Volumes/embedded/zephyr_install/external/zephyr/soc/ambiq/Kconfig.soc"
osource "/Volumes/embedded/zephyr_install/external/zephyr/soc/allwinner/sun8i_h3/Kconfig.soc"
osource "/Volumes/embedded/zephyr_install/external/zephyr/soc/alif/ensemble/Kconfig.soc"
osource "/Volumes/embedded/zephyr_install/external/zephyr/soc/aesc/Kconfig.soc"
osource "/Volumes/embedded/zephyr_install/external/zephyr/soc/adi/max32/Kconfig.soc"
```
