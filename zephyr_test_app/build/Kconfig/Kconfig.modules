## zephyr_test_app/mcuboot_build/Kconfig/soc/Kconfig
```kconfig
# Load Zephyr SoC Kconfig descriptions.
osource "/Volumes/embedded/zephyr_install/external/zephyr/soc/xlnx/zynqmp/Kconfig"
osource "/Volumes/embedded/zephyr_install/external/zephyr/soc/xlnx/zynq7000/Kconfig"
osource "/Volumes/embedded/zephyr_install/external/zephyr/soc/xlnx/versalnet/Kconfig"
osource "/Volumes/embedded/zephyr_install/external/zephyr/soc/xlnx/versal2/Kconfig"
osource "/Volumes/embedded/zephyr_install/external/zephyr/soc/xlnx/versal/Kconfig"
osource "/Volumes/embedded/zephyr_install/external/zephyr/soc/xen/Kconfig"
osource "/Volumes/embedded/zephyr_install/external/zephyr/soc/wch/ch32v/Kconfig"
osource "/Volumes/embedded/zephyr_install/external/zephyr/soc/ti/simplelink/Kconfig"
osource "/Volumes/embedded/zephyr_install/external/zephyr/soc/ti/mspm0/Kconfig"
osource "/Volumes/embedded/zephyr_install/external/zephyr/soc/ti/lm3s6965/Kconfig"
osource "/Volumes/embedded/zephyr_install/external/zephyr/soc/ti/k3/Kconfig"
osource "/Volumes/embedded/zephyr_install/external/zephyr/soc/telink/tlsr/Kconfig"
osource "/Volumes/embedded/zephyr_install/external/zephyr/soc/syna/sr100/Kconfig"
osource "/Volumes/embedded/zephyr_install/external/zephyr/soc/starfive/jh71xx/Kconfig"
osource "/Volumes/embedded/zephyr_install/external/zephyr/soc/st/stm32/Kconfig"
osource "/Volumes/embedded/zephyr_install/external/zephyr/soc/snps/qemu_arc/Kconfig"
osource "/Volumes/embedded/zephyr_install/external/zephyr/soc/snps/nsim/arc_v/Kconfig"
osource "/Volumes/embedded/zephyr_install/external/zephyr/soc/snps/nsim/arc_classic/Kconfig"
osource "/Volumes/embedded/zephyr_install/external/zephyr/soc/snps/hsdk4xd/Kconfig"
osource "/Volumes/embedded/zephyr_install/external/zephyr/soc/snps/hsdk/Kconfig"
osource "/Volumes/embedded/zephyr_install/external/zephyr/soc/snps/emsk/Kconfig"
osource "/Volumes/embedded/zephyr_install/external/zephyr/soc/snps/emsdp/Kconfig"
osource "/Volumes/embedded/zephyr_install/external/zephyr/soc/snps/arc_iot/Kconfig"
osource "/Volumes/embedded/zephyr_install/external/zephyr/soc/silabs/Kconfig"
osource "/Volumes/embedded/zephyr_install/external/zephyr/soc/sifli/sf32/Kconfig"
osource "/Volumes/embedded/zephyr_install/external/zephyr/soc/sifive/sifive_freedom/Kconfig"
osource "/Volumes/embedded/zephyr_install/external/zephyr/soc/sensry/Kconfig"
osource "/Volumes/embedded/zephyr_install/external/zephyr/soc/rockchip/Kconfig"
osource "/Volumes/embedded/zephyr_install/external/zephyr/soc/renode/riscv_virtual/Kconfig"
osource "/Volumes/embedded/zephyr_install/external/zephyr/soc/renode/cortex_r8_virtual/Kconfig"
osource "/Volumes/embedded/zephyr_install/external/zephyr/soc/renesas/smartbond/Kconfig"
osource "/Volumes/embedded/zephyr_install/external/zephyr/soc/renesas/rz/Kconfig"
osource "/Volumes/embedded/zephyr_install/external/zephyr/soc/renesas/rx/Kconfig"
osource "/Volumes/embedded/zephyr_install/external/zephyr/soc/renesas/rcar/Kconfig"
osource "/Volumes/embedded/zephyr_install/external/zephyr/soc/renesas/ra/Kconfig"
osource "/Volumes/embedded/zephyr_install/external/zephyr/soc/realtek/fingerprint/Kconfig"
osource "/Volumes/embedded/zephyr_install/external/zephyr/soc/realtek/ec/Kconfig"
osource "/Volumes/embedded/zephyr_install/external/zephyr/soc/realtek/bee/Kconfig"
osource "/Volumes/embedded/zephyr_install/external/zephyr/soc/realtek/ameba/Kconfig"
osource "/Volumes/embedded/zephyr_install/external/zephyr/soc/raspberrypi/rpi_pico/Kconfig"
osource "/Volumes/embedded/zephyr_install/external/zephyr/soc/quicklogic/eos_s3/Kconfig"
osource "/Volumes/embedded/zephyr_install/external/zephyr/soc/qemu/virt_riscv/Kconfig"
osource "/Volumes/embedded/zephyr_install/external/zephyr/soc/qemu/or1k/Kconfig"
osource "/Volumes/embedded/zephyr_install/external/zephyr/soc/qemu/malta/Kconfig"
osource "/Volumes/embedded/zephyr_install/external/zephyr/soc/openisa/rv32m1/Kconfig"
osource "/Volumes/embedded/zephyr_install/external/zephyr/soc/openhwgroup/cva6/Kconfig"
osource "/Volumes/embedded/zephyr_install/external/zephyr/soc/oct/osd32mp15x/Kconfig"
osource "/Volumes/embedded/zephyr_install/external/zephyr/soc/nxp/s32/Kconfig"
osource "/Volumes/embedded/zephyr_install/external/zephyr/soc/nxp/rw/Kconfig"
osource "/Volumes/embedded/zephyr_install/external/zephyr/soc/nxp/mcx/Kconfig"
osource "/Volumes/embedded/zephyr_install/external/zephyr/soc/nxp/lpc/Kconfig"
osource "/Volumes/embedded/zephyr_install/external/zephyr/soc/nxp/layerscape/Kconfig"
osource "/Volumes/embedded/zephyr_install/external/zephyr/soc/nxp/kinetis/Kconfig"
osource "/Volumes/embedded/zephyr_install/external/zephyr/soc/nxp/imxrt/Kconfig"
osource "/Volumes/embedded/zephyr_install/external/zephyr/soc/nxp/imx/Kconfig"
osource "/Volumes/embedded/zephyr_install/external/zephyr/soc/nuvoton/numicro/Kconfig"
osource "/Volumes/embedded/zephyr_install/external/zephyr/soc/nuvoton/numaker/Kconfig"
osource "/Volumes/embedded/zephyr_install/external/zephyr/soc/nuvoton/npcx/Kconfig"
osource "/Volumes/embedded/zephyr_install/external/zephyr/soc/nuvoton/npcm/Kconfig"
osource "/Volumes/embedded/zephyr_install/external/zephyr/soc/nordic/Kconfig"
osource "/Volumes/embedded/zephyr_install/external/zephyr/soc/neorv32/Kconfig"
osource "/Volumes/embedded/zephyr_install/external/zephyr/soc/native/inf_clock/Kconfig"
osource "/Volumes/embedded/zephyr_install/external/zephyr/soc/microchip/sam/sama7/Kconfig"
osource "/Volumes/embedded/zephyr_install/external/zephyr/soc/microchip/sam/sam_d5x_e5x/Kconfig"
osource "/Volumes/embedded/zephyr_install/external/zephyr/soc/microchip/pic64/Kconfig"
osource "/Volumes/embedded/zephyr_install/external/zephyr/soc/microchip/pic32c/pic32cz_ca/Kconfig"
osource "/Volumes/embedded/zephyr_install/external/zephyr/soc/microchip/pic32c/pic32cx_sg/Kconfig"
osource "/Volumes/embedded/zephyr_install/external/zephyr/soc/microchip/pic32c/pic32cm_pl/Kconfig"
osource "/Volumes/embedded/zephyr_install/external/zephyr/soc/microchip/pic32c/pic32cm_jh/Kconfig"
osource "/Volumes/embedded/zephyr_install/external/zephyr/soc/microchip/miv/Kconfig"
osource "/Volumes/embedded/zephyr_install/external/zephyr/soc/microchip/mec/Kconfig"
osource "/Volumes/embedded/zephyr_install/external/zephyr/soc/mediatek/mt8xxx/Kconfig"
osource "/Volumes/embedded/zephyr_install/external/zephyr/soc/lowrisc/opentitan/Kconfig"
osource "/Volumes/embedded/zephyr_install/external/zephyr/soc/litex/litex_vexriscv/Kconfig"
osource "/Volumes/embedded/zephyr_install/external/zephyr/soc/ite/ec/Kconfig"
osource "/Volumes/embedded/zephyr_install/external/zephyr/soc/intel/wildcat_lake/Kconfig"
osource "/Volumes/embedded/zephyr_install/external/zephyr/soc/intel/raptor_lake/Kconfig"
osource "/Volumes/embedded/zephyr_install/external/zephyr/soc/intel/panther_lake/Kconfig"
osource "/Volumes/embedded/zephyr_install/external/zephyr/soc/intel/lakemont/Kconfig"
osource "/Volumes/embedded/zephyr_install/external/zephyr/soc/intel/intel_socfpga_std/Kconfig"
osource "/Volumes/embedded/zephyr_install/external/zephyr/soc/intel/intel_socfpga/Kconfig"
osource "/Volumes/embedded/zephyr_install/external/zephyr/soc/intel/intel_niosv/Kconfig"
osource "/Volumes/embedded/zephyr_install/external/zephyr/soc/intel/intel_ish/Kconfig"
osource "/Volumes/embedded/zephyr_install/external/zephyr/soc/intel/intel_adsp/Kconfig"
osource "/Volumes/embedded/zephyr_install/external/zephyr/soc/intel/elkhart_lake/Kconfig"
osource "/Volumes/embedded/zephyr_install/external/zephyr/soc/intel/atom/Kconfig"
osource "/Volumes/embedded/zephyr_install/external/zephyr/soc/intel/apollo_lake/Kconfig"
osource "/Volumes/embedded/zephyr_install/external/zephyr/soc/intel/alder_lake/Kconfig"
osource "/Volumes/embedded/zephyr_install/external/zephyr/soc/infineon/psoc4/Kconfig"
osource "/Volumes/embedded/zephyr_install/external/zephyr/soc/infineon/edge/Kconfig"
osource "/Volumes/embedded/zephyr_install/external/zephyr/soc/infineon/cat3/Kconfig"
osource "/Volumes/embedded/zephyr_install/external/zephyr/soc/infineon/cat1c/Kconfig"
osource "/Volumes/embedded/zephyr_install/external/zephyr/soc/infineon/cat1b/Kconfig"
osource "/Volumes/embedded/zephyr_install/external/zephyr/soc/infineon/cat1a/Kconfig"
osource "/Volumes/embedded/zephyr_install/external/zephyr/soc/gd/gd32/Kconfig"
osource "/Volumes/embedded/zephyr_install/external/zephyr/soc/gaisler/leon3/Kconfig"
osource "/Volumes/embedded/zephyr_install/external/zephyr/soc/gaisler/gr716a/Kconfig"
osource "/Volumes/embedded/zephyr_install/external/zephyr/soc/focaltech/Kconfig"
osource "/Volumes/embedded/zephyr_install/external/zephyr/soc/espressif/Kconfig"
osource "/Volumes/embedded/zephyr_install/external/zephyr/soc/ene/kb1200/Kconfig"
osource "/Volumes/embedded/zephyr_install/external/zephyr/soc/ene/kb106x/Kconfig"
osource "/Volumes/embedded/zephyr_install/external/zephyr/soc/elan/em32f967/Kconfig"
osource "/Volumes/embedded/zephyr_install/external/zephyr/soc/egis/Kconfig"
osource "/Volumes/embedded/zephyr_install/external/zephyr/soc/efinix/sapphire/Kconfig"
osource "/Volumes/embedded/zephyr_install/external/zephyr/soc/cdns/xtensa_sample_controller/Kconfig"
osource "/Volumes/embedded/zephyr_install/external/zephyr/soc/cdns/swerv/Kconfig"
osource "/Volumes/embedded/zephyr_install/external/zephyr/soc/cdns/sample_controller32/Kconfig"
osource "/Volumes/embedded/zephyr_install/external/zephyr/soc/cdns/dc233c/Kconfig"
osource "/Volumes/embedded/zephyr_install/external/zephyr/soc/brcm/bcmvk/Kconfig"
osource "/Volumes/embedded/zephyr_install/external/zephyr/soc/brcm/bcm2712/Kconfig"
osource "/Volumes/embedded/zephyr_install/external/zephyr/soc/brcm/bcm2711/Kconfig"
osource "/Volumes/embedded/zephyr_install/external/zephyr/soc/blackberry/qnxhv_vm/Kconfig"
osource "/Volumes/embedded/zephyr_install/external/zephyr/soc/bflb/Kconfig"
osource "/Volumes/embedded/zephyr_install/external/zephyr/soc/atmel/sam0/Kconfig"
osource "/Volumes/embedded/zephyr_install/external/zephyr/soc/atmel/sam/Kconfig"
osource "/Volumes/embedded/zephyr_install/external/zephyr/soc/aspeed/Kconfig"
osource "/Volumes/embedded/zephyr_install/external/zephyr/soc/arm/Kconfig"
osource "/Volumes/embedded/zephyr_install/external/zephyr/soc/arm/beetle/Kconfig"
osource "/Volumes/embedded/zephyr_install/external/zephyr/soc/antmicro/myra/Kconfig"
osource "/Volumes/embedded/zephyr_install/external/zephyr/soc/andestech/Kconfig"
osource "/Volumes/embedded/zephyr_install/external/zephyr/soc/amd/acp_6_0/Kconfig"
osource "/Volumes/embedded/zephyr_install/external/zephyr/soc/ambiq/Kconfig"
osource "/Volumes/embedded/zephyr_install/external/zephyr/soc/allwinner/sun8i_h3/Kconfig"
osource "/Volumes/embedded/zephyr_install/external/zephyr/soc/alif/ensemble/Kconfig"
osource "/Volumes/embedded/zephyr_install/external/zephyr/soc/aesc/Kconfig"
osource "/Volumes/embedded/zephyr_install/external/zephyr/soc/adi/max32/Kconfig"
```
