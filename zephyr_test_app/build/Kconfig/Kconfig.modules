## zephyr_test_app/build/Kconfig/Kconfig.modules
```kconfig
menu "acpica (/Volumes/embedded/zephyr_install/external/modules/lib/acpica)"
osource "$(ZEPHYR_ACPICA_KCONFIG)"
config ZEPHYR_ACPICA_MODULE
	bool
	default y
endmenu
menu "cmsis (/Volumes/embedded/zephyr_install/external/modules/hal/cmsis)"
osource "$(ZEPHYR_CMSIS_KCONFIG)"
config ZEPHYR_CMSIS_MODULE
	bool
	default y
endmenu
menu "cmsis-dsp (/Volumes/embedded/zephyr_install/external/modules/lib/cmsis-dsp)"
osource "$(ZEPHYR_CMSIS_DSP_KCONFIG)"
config ZEPHYR_CMSIS_DSP_MODULE
	bool
	default y
endmenu
menu "cmsis-nn (/Volumes/embedded/zephyr_install/external/modules/lib/cmsis-nn)"
osource "$(ZEPHYR_CMSIS_NN_KCONFIG)"
config ZEPHYR_CMSIS_NN_MODULE
	bool
	default y
endmenu
menu "cmsis_6 (/Volumes/embedded/zephyr_install/external/modules/hal/cmsis_6)"
osource "$(ZEPHYR_CMSIS_6_KCONFIG)"
config ZEPHYR_CMSIS_6_MODULE
	bool
	default y
endmenu
menu "dhara (/Volumes/embedded/zephyr_install/external/modules/lib/dhara)"
osource "$(ZEPHYR_DHARA_KCONFIG)"
config ZEPHYR_DHARA_MODULE
	bool
	default y
endmenu
menu "fatfs (/Volumes/embedded/zephyr_install/external/modules/fs/fatfs)"
osource "$(ZEPHYR_FATFS_KCONFIG)"
config ZEPHYR_FATFS_MODULE
	bool
	default y
endmenu
config ZEPHYR_ADI_MODULE
	bool
	default y
menu "hal_afbr (/Volumes/embedded/zephyr_install/external/modules/hal/afbr)"
osource "$(ZEPHYR_HAL_AFBR_KCONFIG)"
config ZEPHYR_HAL_AFBR_MODULE
	bool
	default y

config ZEPHYR_HAL_AFBR_MODULE_BLOBS
	bool
endmenu
menu "hal_ambiq (/Volumes/embedded/zephyr_install/external/modules/hal/ambiq)"
osource "$(ZEPHYR_HAL_AMBIQ_KCONFIG)"
config ZEPHYR_HAL_AMBIQ_MODULE
	bool
	default y
endmenu
config ZEPHYR_ATMEL_MODULE
	bool
	default y
menu "hal_bouffalolab (/Volumes/embedded/zephyr_install/external/modules/hal/bouffalolab)"
osource "$(ZEPHYR_HAL_BOUFFALOLAB_KCONFIG)"
config ZEPHYR_HAL_BOUFFALOLAB_MODULE
	bool
	default y

config ZEPHYR_HAL_BOUFFALOLAB_MODULE_BLOBS
	bool
endmenu
menu "hal_espressif (/Volumes/embedded/zephyr_install/external/modules/hal/espressif)"
osource "$(ZEPHYR_HAL_ESPRESSIF_KCONFIG)"
config ZEPHYR_HAL_ESPRESSIF_MODULE
	bool
	default y

config ZEPHYR_HAL_ESPRESSIF_MODULE_BLOBS
	bool
endmenu
menu "hal_ethos_u (/Volumes/embedded/zephyr_install/external/modules/hal/ethos_u)"
osource "$(ZEPHYR_HAL_ETHOS_U_KCONFIG)"
config ZEPHYR_HAL_ETHOS_U_MODULE
	bool
	default y
endmenu
menu "hal_gigadevice (/Volumes/embedded/zephyr_install/external/modules/hal/gigadevice)"
osource "$(ZEPHYR_HAL_GIGADEVICE_KCONFIG)"
config ZEPHYR_HAL_GIGADEVICE_MODULE
	bool
	default y
endmenu
menu "hal_infineon (/Volumes/embedded/zephyr_install/external/modules/hal/infineon)"
osource "$(ZEPHYR_HAL_INFINEON_KCONFIG)"
config ZEPHYR_HAL_INFINEON_MODULE
	bool
	default y

config ZEPHYR_HAL_INFINEON_MODULE_BLOBS
	bool
endmenu
menu "hal_intel (/Volumes/embedded/zephyr_install/external/modules/hal/intel)"
osource "/Volumes/embedded/zephyr_install/external/modules/hal/intel/zephyr/Kconfig"
config ZEPHYR_HAL_INTEL_MODULE
	bool
	default y
endmenu
config ZEPHYR_MICROCHIP_MODULE
	bool
	default y
menu "hal_nordic (/Volumes/embedded/zephyr_install/external/modules/hal/nordic)"
osource "$(ZEPHYR_HAL_NORDIC_KCONFIG)"
config ZEPHYR_HAL_NORDIC_MODULE
	bool
	default y

config ZEPHYR_HAL_NORDIC_MODULE_BLOBS
	bool
endmenu
config ZEPHYR_NUVOTON_MODULE
	bool
	default y
menu "hal_nxp (/Volumes/embedded/zephyr_install/external/modules/hal/nxp)"
osource "$(ZEPHYR_HAL_NXP_KCONFIG)"
config ZEPHYR_HAL_NXP_MODULE
	bool
	default y

config ZEPHYR_HAL_NXP_MODULE_BLOBS
	bool
endmenu
config ZEPHYR_OPENISA_MODULE
	bool
	default y
config ZEPHYR_QUICKLOGIC_MODULE
	bool
	default y
menu "hal_realtek (/Volumes/embedded/zephyr_install/external/modules/hal/realtek)"
osource "$(ZEPHYR_HAL_REALTEK_KCONFIG)"
config ZEPHYR_HAL_REALTEK_MODULE
	bool
	default y

config ZEPHYR_HAL_REALTEK_MODULE_BLOBS
	bool
endmenu
config ZEPHYR_HAL_RENESAS_MODULE
	bool
	default y

config ZEPHYR_HAL_RENESAS_MODULE_BLOBS
	bool
menu "hal_rpi_pico (/Volumes/embedded/zephyr_install/external/modules/hal/rpi_pico)"
osource "$(ZEPHYR_HAL_RPI_PICO_KCONFIG)"
config ZEPHYR_HAL_RPI_PICO_MODULE
	bool
	default y
endmenu
menu "hal_sifli (/Volumes/embedded/zephyr_install/external/modules/hal/sifli)"
osource "$(ZEPHYR_HAL_SIFLI_KCONFIG)"
config ZEPHYR_HAL_SIFLI_MODULE
	bool
	default y

config ZEPHYR_HAL_SIFLI_MODULE_BLOBS
	bool
endmenu
menu "hal_silabs (/Volumes/embedded/zephyr_install/external/modules/hal/silabs)"
osource "$(ZEPHYR_HAL_SILABS_KCONFIG)"
config ZEPHYR_HAL_SILABS_MODULE
	bool
	default y

config ZEPHYR_HAL_SILABS_MODULE_BLOBS
	bool
endmenu
menu "hal_st (/Volumes/embedded/zephyr_install/external/modules/hal/st)"
osource "$(ZEPHYR_HAL_ST_KCONFIG)"
config ZEPHYR_HAL_ST_MODULE
	bool
	default y
endmenu
config ZEPHYR_HAL_STM32_MODULE
	bool
	default y

config ZEPHYR_HAL_STM32_MODULE_BLOBS
	bool
menu "hal_tdk (/Volumes/embedded/zephyr_install/external/modules/hal/tdk)"
osource "$(ZEPHYR_HAL_TDK_KCONFIG)"
config ZEPHYR_HAL_TDK_MODULE
	bool
	default y
endmenu
menu "hal_telink (/Volumes/embedded/zephyr_install/external/modules/hal/telink)"
osource "/Volumes/embedded/zephyr_install/external/modules/hal/telink/Kconfig"
config ZEPHYR_HAL_TELINK_MODULE
	bool
	default y
endmenu
config ZEPHYR_TI_MODULE
	bool
	default y
menu "hal_wch (/Volumes/embedded/zephyr_install/external/modules/hal/wch)"
osource "$(ZEPHYR_HAL_WCH_KCONFIG)"
config ZEPHYR_HAL_WCH_MODULE
	bool
	default y
endmenu
config ZEPHYR_HAL_WURTHELEKTRONIK_MODULE
	bool
	default y
config ZEPHYR_XTENSA_MODULE
	bool
	default y
menu "hostap (/Volumes/embedded/zephyr_install/external/modules/lib/hostap)"
osource "$(ZEPHYR_HOSTAP_KCONFIG)"
config ZEPHYR_HOSTAP_MODULE
	bool
	default y
endmenu
menu "liblc3 (/Volumes/embedded/zephyr_install/external/modules/lib/liblc3)"
osource "$(ZEPHYR_LIBLC3_KCONFIG)"
config ZEPHYR_LIBLC3_MODULE
	bool
	default y
endmenu
config ZEPHYR_LIBMCTP_MODULE
	bool
	default y
config ZEPHYR_LIBMETAL_MODULE
	bool
	default y
menu "libsbc (/Volumes/embedded/zephyr_install/external/modules/lib/libsbc)"
osource "$(ZEPHYR_LIBSBC_KCONFIG)"
config ZEPHYR_LIBSBC_MODULE
	bool
	default y
endmenu
menu "littlefs (/Volumes/embedded/zephyr_install/external/modules/fs/littlefs)"
osource "$(ZEPHYR_LITTLEFS_KCONFIG)"
config ZEPHYR_LITTLEFS_MODULE
	bool
	default y
endmenu
menu "lora-basics-modem (/Volumes/embedded/zephyr_install/external/modules/lib/lora-basics-modem)"
osource "$(ZEPHYR_LORA_BASICS_MODEM_KCONFIG)"
config ZEPHYR_LORA_BASICS_MODEM_MODULE
	bool
	default y
endmenu
menu "loramac-node (/Volumes/embedded/zephyr_install/external/modules/lib/loramac-node)"
osource "$(ZEPHYR_LORAMAC_NODE_KCONFIG)"
config ZEPHYR_LORAMAC_NODE_MODULE
	bool
	default y
endmenu
menu "lvgl (/Volumes/embedded/zephyr_install/external/modules/lib/gui/lvgl)"
osource "/Volumes/embedded/zephyr_install/external/modules/lib/gui/lvgl/zephyr/Kconfig"
config ZEPHYR_LVGL_MODULE
	bool
	default y
endmenu
menu "mbedtls (/Volumes/embedded/zephyr_install/external/modules/crypto/mbedtls)"
osource "$(ZEPHYR_MBEDTLS_KCONFIG)"
config ZEPHYR_MBEDTLS_MODULE
	bool
	default y
endmenu
config ZEPHYR_MBEDTLS_3_6_MODULE
	bool
	default y
config ZEPHYR_MCUBOOT_MODULE
	bool
	default y
config ZEPHYR_MIPI_SYS_T_MODULE
	bool
	default y
config ZEPHYR_MLDSA_NATIVE_MODULE
	bool
	default y
menu "nanopb (/Volumes/embedded/zephyr_install/external/modules/lib/nanopb)"
osource "$(ZEPHYR_NANOPB_KCONFIG)"
config ZEPHYR_NANOPB_MODULE
	bool
	default y
endmenu
menu "nrf_wifi (/Volumes/embedded/zephyr_install/external/modules/lib/nrf_wifi)"
osource "$(ZEPHYR_NRF_WIFI_KCONFIG)"
config ZEPHYR_NRF_WIFI_MODULE
	bool
	default y

config ZEPHYR_NRF_WIFI_MODULE_BLOBS
	bool
endmenu
config ZEPHYR_OPEN_AMP_MODULE
	bool
	default y
menu "openthread (/Volumes/embedded/zephyr_install/external/modules/lib/openthread)"
osource "$(ZEPHYR_OPENTHREAD_KCONFIG)"
config ZEPHYR_OPENTHREAD_MODULE
	bool
	default y
endmenu
menu "percepio (/Volumes/embedded/zephyr_install/external/modules/debug/percepio)"
osource "/Volumes/embedded/zephyr_install/external/modules/debug/percepio/zephyr/Kconfig"
config ZEPHYR_PERCEPIO_MODULE
	bool
	default y
endmenu
menu "picolibc (/Volumes/embedded/zephyr_install/external/modules/lib/picolibc)"
osource "/Volumes/embedded/zephyr_install/external/modules/lib/picolibc/zephyr/Kconfig"
config ZEPHYR_PICOLIBC_MODULE
	bool
	default y
endmenu
config ZEPHYR_PSA_ARCH_TESTS_MODULE
	bool
	default y
menu "segger (/Volumes/embedded/zephyr_install/external/modules/debug/segger)"
osource "$(ZEPHYR_SEGGER_KCONFIG)"
config ZEPHYR_SEGGER_MODULE
	bool
	default y
endmenu
config ZEPHYR_TF_M_TESTS_MODULE
	bool
	default y
config ZEPHYR_TF_PSA_CRYPTO_MODULE
	bool
	default y
menu "trusted-firmware-a (/Volumes/embedded/zephyr_install/external/modules/tee/tf-a/trusted-firmware-a)"
osource "$(ZEPHYR_TRUSTED_FIRMWARE_A_KCONFIG)"
config ZEPHYR_TRUSTED_FIRMWARE_A_MODULE
	bool
	default y
endmenu
menu "trusted-firmware-m (/Volumes/embedded/zephyr_install/external/modules/tee/tf-m/trusted-firmware-m)"
osource "$(ZEPHYR_TRUSTED_FIRMWARE_M_KCONFIG)"
config ZEPHYR_TRUSTED_FIRMWARE_M_MODULE
	bool
	default y
endmenu
menu "uoscore-uedhoc (/Volumes/embedded/zephyr_install/external/modules/lib/uoscore-uedhoc)"
osource "$(ZEPHYR_UOSCORE_UEDHOC_KCONFIG)"
config ZEPHYR_UOSCORE_UEDHOC_MODULE
	bool
	default y
endmenu
menu "zcbor (/Volumes/embedded/zephyr_install/external/modules/lib/zcbor)"
osource "$(ZEPHYR_ZCBOR_KCONFIG)"
config ZEPHYR_ZCBOR_MODULE
	bool
	default y
endmenu
config ZEPHYR_NRF_HW_MODELS_MODULE
	bool
	default y
```

## zephyr_test_app/build/Kconfig/arch/Kconfig
```kconfig
# Load Zephyr Arch Kconfig descriptions.
osource "/Volumes/embedded/zephyr_install/external/zephyr/arch/rx/Kconfig"
osource "/Volumes/embedded/zephyr_install/external/zephyr/arch/x86/Kconfig"
osource "/Volumes/embedded/zephyr_install/external/zephyr/arch/xtensa/Kconfig"
osource "/Volumes/embedded/zephyr_install/external/zephyr/arch/sparc/Kconfig"
osource "/Volumes/embedded/zephyr_install/external/zephyr/arch/riscv/Kconfig"
osource "/Volumes/embedded/zephyr_install/external/zephyr/arch/posix/Kconfig"
osource "/Volumes/embedded/zephyr_install/external/zephyr/arch/openrisc/Kconfig"
osource "/Volumes/embedded/zephyr_install/external/zephyr/arch/mips/Kconfig"
osource "/Volumes/embedded/zephyr_install/external/zephyr/arch/arm64/Kconfig"
osource "/Volumes/embedded/zephyr_install/external/zephyr/arch/arm/Kconfig"
osource "/Volumes/embedded/zephyr_install/external/zephyr/arch/arc/Kconfig"
```

## zephyr_test_app/build/Kconfig/boards/Kconfig.tmp
```kconfig
# Load Zephyr board Kconfig descriptions.
osource "/Volumes/embedded/zephyr_install/external/zephyr/boards/nxp/frdm_mcxa156/Kconfig"
```
