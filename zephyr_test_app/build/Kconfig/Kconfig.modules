## zephyr_test_app/build/Kconfig/soc/Kconfig.sysbuild
```kconfig
# Load Sysbuild SoC Kconfig descriptions.
osource "/Volumes/embedded/zephyr_install/external/zephyr/soc/xlnx/zynqmp/Kconfig.sysbuild"
osource "/Volumes/embedded/zephyr_install/external/zephyr/soc/xlnx/zynq7000/Kconfig.sysbuild"
osource "/Volumes/embedded/zephyr_install/external/zephyr/soc/xlnx/versalnet/Kconfig.sysbuild"
osource "/Volumes/embedded/zephyr_install/external/zephyr/soc/xlnx/versal2/Kconfig.sysbuild"
osource "/Volumes/embedded/zephyr_install/external/zephyr/soc/xlnx/versal/Kconfig.sysbuild"
osource "/Volumes/embedded/zephyr_install/external/zephyr/soc/xen/Kconfig.sysbuild"
osource "/Volumes/embedded/zephyr_install/external/zephyr/soc/wch/ch32v/Kconfig.sysbuild"
osource "/Volumes/embedded/zephyr_install/external/zephyr/soc/ti/simplelink/Kconfig.sysbuild"
osource "/Volumes/embedded/zephyr_install/external/zephyr/soc/ti/mspm0/Kconfig.sysbuild"
osource "/Volumes/embedded/zephyr_install/external/zephyr/soc/ti/lm3s6965/Kconfig.sysbuild"
osource "/Volumes/embedded/zephyr_install/external/zephyr/soc/ti/k3/Kconfig.sysbuild"
osource "/Volumes/embedded/zephyr_install/external/zephyr/soc/telink/tlsr/Kconfig.sysbuild"
osource "/Volumes/embedded/zephyr_install/external/zephyr/soc/syna/sr100/Kconfig.sysbuild"
osource "/Volumes/embedded/zephyr_install/external/zephyr/soc/starfive/jh71xx/Kconfig.sysbuild"
osource "/Volumes/embedded/zephyr_install/external/zephyr/soc/st/stm32/Kconfig.sysbuild"
osource "/Volumes/embedded/zephyr_install/external/zephyr/soc/snps/qemu_arc/Kconfig.sysbuild"
osource "/Volumes/embedded/zephyr_install/external/zephyr/soc/snps/nsim/arc_v/Kconfig.sysbuild"
osource "/Volumes/embedded/zephyr_install/external/zephyr/soc/snps/nsim/arc_classic/Kconfig.sysbuild"
osource "/Volumes/embedded/zephyr_install/external/zephyr/soc/snps/hsdk4xd/Kconfig.sysbuild"
osource "/Volumes/embedded/zephyr_install/external/zephyr/soc/snps/hsdk/Kconfig.sysbuild"
osource "/Volumes/embedded/zephyr_install/external/zephyr/soc/snps/emsk/Kconfig.sysbuild"
osource "/Volumes/embedded/zephyr_install/external/zephyr/soc/snps/emsdp/Kconfig.sysbuild"
osource "/Volumes/embedded/zephyr_install/external/zephyr/soc/snps/arc_iot/Kconfig.sysbuild"
osource "/Volumes/embedded/zephyr_install/external/zephyr/soc/silabs/Kconfig.sysbuild"
osource "/Volumes/embedded/zephyr_install/external/zephyr/soc/sifli/sf32/Kconfig.sysbuild"
osource "/Volumes/embedded/zephyr_install/external/zephyr/soc/sifive/sifive_freedom/Kconfig.sysbuild"
osource "/Volumes/embedded/zephyr_install/external/zephyr/soc/sensry/Kconfig.sysbuild"
osource "/Volumes/embedded/zephyr_install/external/zephyr/soc/rockchip/Kconfig.sysbuild"
osource "/Volumes/embedded/zephyr_install/external/zephyr/soc/renode/riscv_virtual/Kconfig.sysbuild"
osource "/Volumes/embedded/zephyr_install/external/zephyr/soc/renode/cortex_r8_virtual/Kconfig.sysbuild"
osource "/Volumes/embedded/zephyr_install/external/zephyr/soc/renesas/smartbond/Kconfig.sysbuild"
osource "/Volumes/embedded/zephyr_install/external/zephyr/soc/renesas/rz/Kconfig.sysbuild"
osource "/Volumes/embedded/zephyr_install/external/zephyr/soc/renesas/rx/Kconfig.sysbuild"
osource "/Volumes/embedded/zephyr_install/external/zephyr/soc/renesas/rcar/Kconfig.sysbuild"
osource "/Volumes/embedded/zephyr_install/external/zephyr/soc/renesas/ra/Kconfig.sysbuild"
osource "/Volumes/embedded/zephyr_install/external/zephyr/soc/realtek/fingerprint/Kconfig.sysbuild"
osource "/Volumes/embedded/zephyr_install/external/zephyr/soc/realtek/ec/Kconfig.sysbuild"
osource "/Volumes/embedded/zephyr_install/external/zephyr/soc/realtek/bee/Kconfig.sysbuild"
osource "/Volumes/embedded/zephyr_install/external/zephyr/soc/realtek/ameba/Kconfig.sysbuild"
osource "/Volumes/embedded/zephyr_install/external/zephyr/soc/raspberrypi/rpi_pico/Kconfig.sysbuild"
osource "/Volumes/embedded/zephyr_install/external/zephyr/soc/quicklogic/eos_s3/Kconfig.sysbuild"
osource "/Volumes/embedded/zephyr_install/external/zephyr/soc/qemu/virt_riscv/Kconfig.sysbuild"
osource "/Volumes/embedded/zephyr_install/external/zephyr/soc/qemu/or1k/Kconfig.sysbuild"
osource "/Volumes/embedded/zephyr_install/external/zephyr/soc/qemu/malta/Kconfig.sysbuild"
osource "/Volumes/embedded/zephyr_install/external/zephyr/soc/openisa/rv32m1/Kconfig.sysbuild"
osource "/Volumes/embedded/zephyr_install/external/zephyr/soc/openhwgroup/cva6/Kconfig.sysbuild"
osource "/Volumes/embedded/zephyr_install/external/zephyr/soc/oct/osd32mp15x/Kconfig.sysbuild"
osource "/Volumes/embedded/zephyr_install/external/zephyr/soc/nxp/s32/Kconfig.sysbuild"
osource "/Volumes/embedded/zephyr_install/external/zephyr/soc/nxp/rw/Kconfig.sysbuild"
osource "/Volumes/embedded/zephyr_install/external/zephyr/soc/nxp/mcx/Kconfig.sysbuild"
osource "/Volumes/embedded/zephyr_install/external/zephyr/soc/nxp/lpc/Kconfig.sysbuild"
osource "/Volumes/embedded/zephyr_install/external/zephyr/soc/nxp/layerscape/Kconfig.sysbuild"
osource "/Volumes/embedded/zephyr_install/external/zephyr/soc/nxp/kinetis/Kconfig.sysbuild"
osource "/Volumes/embedded/zephyr_install/external/zephyr/soc/nxp/imxrt/Kconfig.sysbuild"
osource "/Volumes/embedded/zephyr_install/external/zephyr/soc/nxp/imx/Kconfig.sysbuild"
osource "/Volumes/embedded/zephyr_install/external/zephyr/soc/nuvoton/numicro/Kconfig.sysbuild"
osource "/Volumes/embedded/zephyr_install/external/zephyr/soc/nuvoton/numaker/Kconfig.sysbuild"
osource "/Volumes/embedded/zephyr_install/external/zephyr/soc/nuvoton/npcx/Kconfig.sysbuild"
osource "/Volumes/embedded/zephyr_install/external/zephyr/soc/nuvoton/npcm/Kconfig.sysbuild"
osource "/Volumes/embedded/zephyr_install/external/zephyr/soc/nordic/Kconfig.sysbuild"
osource "/Volumes/embedded/zephyr_install/external/zephyr/soc/neorv32/Kconfig.sysbuild"
osource "/Volumes/embedded/zephyr_install/external/zephyr/soc/native/inf_clock/Kconfig.sysbuild"
osource "/Volumes/embedded/zephyr_install/external/zephyr/soc/microchip/sam/sama7/Kconfig.sysbuild"
osource "/Volumes/embedded/zephyr_install/external/zephyr/soc/microchip/sam/sam_d5x_e5x/Kconfig.sysbuild"
osource "/Volumes/embedded/zephyr_install/external/zephyr/soc/microchip/pic64/Kconfig.sysbuild"
osource "/Volumes/embedded/zephyr_install/external/zephyr/soc/microchip/pic32c/pic32cz_ca/Kconfig.sysbuild"
osource "/Volumes/embedded/zephyr_install/external/zephyr/soc/microchip/pic32c/pic32cx_sg/Kconfig.sysbuild"
osource "/Volumes/embedded/zephyr_install/external/zephyr/soc/microchip/pic32c/pic32cm_pl/Kconfig.sysbuild"
osource "/Volumes/embedded/zephyr_install/external/zephyr/soc/microchip/pic32c/pic32cm_jh/Kconfig.sysbuild"
osource "/Volumes/embedded/zephyr_install/external/zephyr/soc/microchip/miv/Kconfig.sysbuild"
osource "/Volumes/embedded/zephyr_install/external/zephyr/soc/microchip/mec/Kconfig.sysbuild"
osource "/Volumes/embedded/zephyr_install/external/zephyr/soc/mediatek/mt8xxx/Kconfig.sysbuild"
osource "/Volumes/embedded/zephyr_install/external/zephyr/soc/lowrisc/opentitan/Kconfig.sysbuild"
osource "/Volumes/embedded/zephyr_install/external/zephyr/soc/litex/litex_vexriscv/Kconfig.sysbuild"
osource "/Volumes/embedded/zephyr_install/external/zephyr/soc/ite/ec/Kconfig.sysbuild"
osource "/Volumes/embedded/zephyr_install/external/zephyr/soc/intel/wildcat_lake/Kconfig.sysbuild"
osource "/Volumes/embedded/zephyr_install/external/zephyr/soc/intel/raptor_lake/Kconfig.sysbuild"
osource "/Volumes/embedded/zephyr_install/external/zephyr/soc/intel/panther_lake/Kconfig.sysbuild"
osource "/Volumes/embedded/zephyr_install/external/zephyr/soc/intel/lakemont/Kconfig.sysbuild"
osource "/Volumes/embedded/zephyr_install/external/zephyr/soc/intel/intel_socfpga_std/Kconfig.sysbuild"
osource "/Volumes/embedded/zephyr_install/external/zephyr/soc/intel/intel_socfpga/Kconfig.sysbuild"
osource "/Volumes/embedded/zephyr_install/external/zephyr/soc/intel/intel_niosv/Kconfig.sysbuild"
osource "/Volumes/embedded/zephyr_install/external/zephyr/soc/intel/intel_ish/Kconfig.sysbuild"
osource "/Volumes/embedded/zephyr_install/external/zephyr/soc/intel/intel_adsp/Kconfig.sysbuild"
osource "/Volumes/embedded/zephyr_install/external/zephyr/soc/intel/elkhart_lake/Kconfig.sysbuild"
osource "/Volumes/embedded/zephyr_install/external/zephyr/soc/intel/atom/Kconfig.sysbuild"
osource "/Volumes/embedded/zephyr_install/external/zephyr/soc/intel/apollo_lake/Kconfig.sysbuild"
osource "/Volumes/embedded/zephyr_install/external/zephyr/soc/intel/alder_lake/Kconfig.sysbuild"
osource "/Volumes/embedded/zephyr_install/external/zephyr/soc/infineon/psoc4/Kconfig.sysbuild"
osource "/Volumes/embedded/zephyr_install/external/zephyr/soc/infineon/edge/Kconfig.sysbuild"
osource "/Volumes/embedded/zephyr_install/external/zephyr/soc/infineon/cat3/Kconfig.sysbuild"
osource "/Volumes/embedded/zephyr_install/external/zephyr/soc/infineon/cat1c/Kconfig.sysbuild"
osource "/Volumes/embedded/zephyr_install/external/zephyr/soc/infineon/cat1b/Kconfig.sysbuild"
osource "/Volumes/embedded/zephyr_install/external/zephyr/soc/infineon/cat1a/Kconfig.sysbuild"
osource "/Volumes/embedded/zephyr_install/external/zephyr/soc/gd/gd32/Kconfig.sysbuild"
osource "/Volumes/embedded/zephyr_install/external/zephyr/soc/gaisler/leon3/Kconfig.sysbuild"
osource "/Volumes/embedded/zephyr_install/external/zephyr/soc/gaisler/gr716a/Kconfig.sysbuild"
osource "/Volumes/embedded/zephyr_install/external/zephyr/soc/focaltech/Kconfig.sysbuild"
osource "/Volumes/embedded/zephyr_install/external/zephyr/soc/espressif/Kconfig.sysbuild"
osource "/Volumes/embedded/zephyr_install/external/zephyr/soc/ene/kb1200/Kconfig.sysbuild"
osource "/Volumes/embedded/zephyr_install/external/zephyr/soc/ene/kb106x/Kconfig.sysbuild"
osource "/Volumes/embedded/zephyr_install/external/zephyr/soc/elan/em32f967/Kconfig.sysbuild"
osource "/Volumes/embedded/zephyr_install/external/zephyr/soc/egis/Kconfig.sysbuild"
osource "/Volumes/embedded/zephyr_install/external/zephyr/soc/efinix/sapphire/Kconfig.sysbuild"
osource "/Volumes/embedded/zephyr_install/external/zephyr/soc/cdns/xtensa_sample_controller/Kconfig.sysbuild"
osource "/Volumes/embedded/zephyr_install/external/zephyr/soc/cdns/swerv/Kconfig.sysbuild"
osource "/Volumes/embedded/zephyr_install/external/zephyr/soc/cdns/sample_controller32/Kconfig.sysbuild"
osource "/Volumes/embedded/zephyr_install/external/zephyr/soc/cdns/dc233c/Kconfig.sysbuild"
osource "/Volumes/embedded/zephyr_install/external/zephyr/soc/brcm/bcmvk/Kconfig.sysbuild"
osource "/Volumes/embedded/zephyr_install/external/zephyr/soc/brcm/bcm2712/Kconfig.sysbuild"
osource "/Volumes/embedded/zephyr_install/external/zephyr/soc/brcm/bcm2711/Kconfig.sysbuild"
osource "/Volumes/embedded/zephyr_install/external/zephyr/soc/blackberry/qnxhv_vm/Kconfig.sysbuild"
osource "/Volumes/embedded/zephyr_install/external/zephyr/soc/bflb/Kconfig.sysbuild"
osource "/Volumes/embedded/zephyr_install/external/zephyr/soc/atmel/sam0/Kconfig.sysbuild"
osource "/Volumes/embedded/zephyr_install/external/zephyr/soc/atmel/sam/Kconfig.sysbuild"
osource "/Volumes/embedded/zephyr_install/external/zephyr/soc/aspeed/Kconfig.sysbuild"
osource "/Volumes/embedded/zephyr_install/external/zephyr/soc/arm/Kconfig.sysbuild"
osource "/Volumes/embedded/zephyr_install/external/zephyr/soc/arm/beetle/Kconfig.sysbuild"
osource "/Volumes/embedded/zephyr_install/external/zephyr/soc/antmicro/myra/Kconfig.sysbuild"
osource "/Volumes/embedded/zephyr_install/external/zephyr/soc/andestech/Kconfig.sysbuild"
osource "/Volumes/embedded/zephyr_install/external/zephyr/soc/amd/acp_6_0/Kconfig.sysbuild"
osource "/Volumes/embedded/zephyr_install/external/zephyr/soc/ambiq/Kconfig.sysbuild"
osource "/Volumes/embedded/zephyr_install/external/zephyr/soc/allwinner/sun8i_h3/Kconfig.sysbuild"
osource "/Volumes/embedded/zephyr_install/external/zephyr/soc/alif/ensemble/Kconfig.sysbuild"
osource "/Volumes/embedded/zephyr_install/external/zephyr/soc/aesc/Kconfig.sysbuild"
osource "/Volumes/embedded/zephyr_install/external/zephyr/soc/adi/max32/Kconfig.sysbuild"
```

## zephyr_test_app/mcuboot_build/Kconfig/boards/Kconfig.defconfig
```kconfig
# Load Zephyr board defconfig descriptions.
osource "/Volumes/embedded/zephyr_install/external/zephyr/boards/nxp/frdm_mcxa156/Kconfig.defconfig"
```
